## boards/shields/achroma/Kconfig.defconfig
```kconfig
if SHIELD_ACHROMA_LEFT

config ZMK_KEYBOARD_NAME
    default "Achroma"

config ZMK_SPLIT_ROLE_CENTRAL
    default y

endif

if SHIELD_ACHROMA_LEFT || SHIELD_ACHROMA_RIGHT

config ZMK_SPLIT
    default y

endif
```

## boards/shields/achroma/Kconfig.shield
```kconfig
config SHIELD_ACHROMA_LEFT
    def_bool $(shields_list_contains,achroma_left)

config SHIELD_ACHROMA_RIGHT
    def_bool $(shields_list_contains,achroma_right)
```

## dts/bindings/zmk,physical-layout.yaml
```yaml
# zmk-achroma-module/dts/bindings/zmk,physical-layout.yaml
description: Custom out-of-tree hardware matrix layout mapping binding schema

compatible: "zmk,physical-layout"

include: base.yaml

properties:
  display-name:
    type: string
    required: true
    description: Human readable name displayed on configuration layouts
  transform:
    type: phandle
    required: true
    description: Handle pointer mapping to the target keymap matrix transform node
  kscan:
    type: phandle
    required: false
    description: Handle pointer mapping to the physical hardware GPIO matrix scanner node
```
